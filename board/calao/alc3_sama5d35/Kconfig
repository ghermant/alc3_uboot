## board/calao/alc3_sama5d35/Kconfig
```kconfig
if TARGET_ALC3_SAMA5D35

config SYS_BOARD
	default "alc3_sama5d35"

config SYS_VENDOR
	default "calao"

config SYS_SOC
	default "at91"

config SYS_CONFIG_NAME
	default "alc3_sama5d35"

endif
```

## configs/alc3_sama5d35_spiflash_defconfig
```kconfig
CONFIG_SPL=y
CONFIG_SYS_EXTRA_OPTIONS="SAMA5D3,SYS_USE_SERIALFLASH"
+S:CONFIG_ARM=y
+S:CONFIG_TARGET_ALC3_SAMA5D35=y
CONFIG_CMD_USB=y
CONFIG_USB_GADGET=y
```
